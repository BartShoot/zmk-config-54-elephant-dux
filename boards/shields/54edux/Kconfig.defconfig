## boards/shields/54edux/Kconfig.defconfig
```kconfig
if SHIELD_54EDUX_LEFT

config ZMK_KEYBOARD_NAME
	default "54edux"

config ZMK_SPLIT_ROLE_CENTRAL
	default y

endif

if SHIELD_54EDUX_LEFT || SHIELD_54EDUX_RIGHT

config ZMK_SPLIT
	default y

endif
```

## boards/shields/54edux/Kconfig.shield
```kconfig
config SHIELD_54EDUX_LEFT
	def_bool $(shields_list_contains,54edux_left)

config SHIELD_54EDUX_RIGHT
	def_bool $(shields_list_contains,54edux_right)
```
